## Kconfig
```kconfig
menu "K-FSW services"

config KFSW_LOG_MIN_LEVEL
	int "Minimum K-FSW log level"
	range 0 4
	default 1
	help
	  Compile messages at or above this severity. Values are 0 for DEBUG,
	  1 for INFO, 2 for WARNING, 3 for ERROR, and 4 to disable logging.

config KFSW_LOG_COLOR
	bool "Colour log lines on the console"
	default y
	help
	  Colour log lines by level: errors red, warnings yellow, info white and
	  debug dim. Turn it off for consoles that don't support VT100 escapes.

config KFSW_PARAM
	bool "K-FSW parameter service"
	select CBPRINTF_FP_SUPPORT
	help
	  Enable the local parameter tables and API. CSP is not needed.

if KFSW_PARAM

config KFSW_PARAM_MAX_DEFINITIONS
	int "Parameters the local table can hold"
	default 160
	range 1 512
	help
	  Total parameters across all tables. Registration is refused once this
	  is full.

config KFSW_PARAM_STRING_MAX
	int "Longest string parameter, including the terminator"
	default 104
	range 8 256
	help
	  Bounds every string parameter and the value buffer callers pass on the
	  stack. The largest value in use is the libcsp route table, which the
	  pinned parser caps at 99 characters.

config KFSW_PARAM_MAX_TABLES
	int "Parameter tables the node can register"
	default 24
	range 1 100
	help
	  Number of parameter tables. Tables registered after this limit are
	  rejected with an error.

config KFSW_PARAM_PERSIST_SAVE_WARN
	int "Snapshots in one boot before the log says so"
	depends on KFSW_PARAM_PERSISTENCE
	default 1000
	range 0 1000000
	help
	  Log a warning once this many snapshots have been written since boot.
	  With autosave on, each accepted change to a persistent value writes
	  one. 0 disables the warning.

config KFSW_PARAM_PERSISTENCE
	bool "Explicit LittleFS parameter snapshots"
	depends on KFSW_STORAGE
	select CRC
	help
	  Save persistent parameters in a versioned snapshot under /kfsw/params
	  and restore them at boot.

endif # KFSW_PARAM

config KFSW_PARAM_CSP
	bool "K-FSW parameter CSP adapter"
	depends on KFSW_PARAM && KFSW_CSP
	select CRC
	help
	  Expose the local parameter table over the established libparam CSP wire
	  protocol and enable remote parameter client/cache operations.

if KFSW_PARAM_CSP

config KFSW_PARAM_PORT
	int "CSP parameter transaction port"
	range 1 CSP_PORT_MAX_BIND
	default 10
	help
	  CSP port used for libparam version 2 pull and push transactions.
	  Upstream libparam currently defaults to port 10.

config KFSW_PARAM_LIST_PORT
	int "CSP parameter-list port"
	range 1 CSP_PORT_MAX_BIND
	default 12
	help
	  CSP port used by the upstream version 3 parameter-list wire format.

config KFSW_PARAM_REMOTE_POOL_SIZE
	int "Preallocated remote parameter descriptors"
	range 5 512
	default KFSW_PARAM_MAX_DEFINITIONS
	help
	  Remote parameter descriptors cached without dynamic memory. It has to
	  hold the largest table set a node lists, or the download fails with
	  -ENOSPC.

config KFSW_PARAM_TIMEOUT_MS
	int "Remote parameter timeout in milliseconds"
	range 10 60000
	default 1000

config KFSW_PARAM_LIST_TIMEOUT_MS
	int "Total remote descriptor refresh budget in milliseconds"
	range 100 120000
	default 10000
	help
	  Time limit for downloading a remote node's descriptors. About a
	  hundred descriptors take under a second over CAN at 500 kbit/s and
	  35 seconds over a 57600 baud radio, so raise it for radio links.

config KFSW_PARAM_LIST_RDP
	bool "Allow legacy parameter-list clients using RDP"
	default y
	help
	  Legacy v3 clients can use RDP when libcsp is built with CSP_USE_RDP.
	  K-FSW clients use indexed v4 replies with a count and table CRC.

config KFSW_PARAM_LIST_STACK_SIZE
	int "Parameter-list server thread stack size"
	default 2048

config KFSW_PARAM_LIST_PRIORITY
	int "Parameter-list server thread priority"
	default 1

config KFSW_PARAM_VALUE_QUEUE_DEPTH
	int "Queued parameter value requests"
	range 1 8
	default 2
	help
	  Each queued request holds one CSP packet, plus one in the worker.
	  Leave buffer capacity for routing, replies and list transfers.

config KFSW_PARAM_VALUE_STACK_SIZE
	int "Parameter value worker stack size"
	range 1536 8192
	default 3072

config KFSW_PARAM_VALUE_PRIORITY
	int "Parameter value worker priority"
	range 2 15
	default 3
	help
	  Keep below the CSP router. Sampling and change callbacks run here.

endif # KFSW_PARAM_CSP

config KFSW_FTP
	bool "K-FSW file transfer service"
	depends on KFSW_CSP && KFSW_STORAGE
	select CRC
	help
	  Enable the bounded K-FSW file transfer client and server. All paths are
	  sandboxed below /kfsw/ftp and all CSP connections require RDP and CRC32.

if KFSW_FTP

config KFSW_FTP_CSP_PORT
	int "CSP file transfer port"
	range 1 CSP_PORT_MAX_BIND
	default 9

config KFSW_FTP_TIMEOUT_MS
	int "File transfer receive timeout in milliseconds"
	range 1000 120000
	default 15000
	help
	  Timeout for each protocol message. This must remain longer than the
	  libcsp RDP connection timeout used by the application.

config KFSW_FTP_WORKER_STACK_SIZE
	int "File transfer worker thread stack size"
	range 1024 16384
	default 3072

config KFSW_FTP_WORKER_PRIORITY
	int "File transfer worker thread priority"
	default 2

config KFSW_FTP_ACCEPTOR_STACK_SIZE
	int "File transfer acceptor thread stack size"
	range 768 8192
	default 1536

config KFSW_FTP_ACCEPTOR_PRIORITY
	int "File transfer acceptor thread priority"
	default 2

endif # KFSW_FTP

config KFSW_EVENT
	bool "K-FSW structured event record"
	help
	  Record numeric events in a RAM ring: ID, timestamp, sequence number
	  and a small payload. The ring does not survive a reset.

if KFSW_EVENT

config KFSW_EVENT_RING_DEPTH
	int "Recorded events held in memory"
	range 8 256
	default 32
	help
	  When the ring is full the oldest record is overwritten and the
	  overwritten counter increases.

endif # KFSW_EVENT

config KFSW_COMMAND
	bool "K-FSW command service"
	help
	  Enable the command registry. Commands are registered at build time and
	  called by name from the shell or by ID over CSP.

if KFSW_COMMAND

config KFSW_COMMAND_MAX_COMMANDS
	int "Maximum registered commands"
	range 4 64
	default 16
	help
	  Bounds the static registry. Startup fails if the composed definition
	  sets exceed this count.

config KFSW_COMMAND_CSP
	bool "Expose commands over CSP"
	depends on KFSW_CSP
	help
	  Serve command requests on a dedicated CSP port. Without this the
	  registry is reachable only from local callers such as the shell.

if KFSW_COMMAND_CSP

config KFSW_COMMAND_CSP_PORT
	int "CSP command port"
	range 1 CSP_PORT_MAX_BIND
	default 11
	help
	  Distinct from file transfer (9) and the parameter adapter (10, 12).

config KFSW_COMMAND_TIMEOUT_MS
	int "Command receive timeout in milliseconds"
	range 1000 120000
	default 10000

config KFSW_COMMAND_SERVER_STACK_SIZE
	int "Command server thread stack size"
	range 1024 16384
	default 3072

config KFSW_COMMAND_SERVER_PRIORITY
	int "Command server thread priority"
	default 2

endif # KFSW_COMMAND_CSP

endif # KFSW_COMMAND

config KFSW_FWU
	bool "K-FSW firmware update"
	depends on FLASH
	depends on FLASH_MAP
	select STREAM_FLASH
	select CRC
	help
	  Receive a firmware image into the secondary slot selected by the
	  kfsw,fwu-partition chosen property, check its CRC32 and offer it to
	  the bootloader. The image is written straight to flash because it
	  doesn't fit in the filesystem partition.

config KFSW_FWU_MCUBOOT
	bool "Offer completed images to MCUboot"
	depends on KFSW_FWU
	depends on BOOTLOADER_MCUBOOT
	depends on IMG_MANAGER
	default y
	help
	  Mark a completed image for a trial boot and check that the bootloader
	  scheduled the swap. The unit tests turn this off because they have no
	  bootloader.

config KFSW_FWU_FILES
	bool "Read firmware slots as files"
	depends on KFSW_FWU && FILE_SYSTEM && MCUBOOT_BOOTUTIL_LIB
	default y
	help
	  Mount /kfsw/boot with read-only firmware_1.bin and firmware_2.bin
	  backed by slot0 and the update partition. No image copy is stored in
	  the data filesystem. FILE_SYSTEM_MAX_FILE_NAME must allow 14 bytes.

config KFSW_FWU_FILE_HANDLES
	int "Open firmware slot files"
	depends on KFSW_FWU_FILES
	default 4
	range 1 8

config KFSW_FWU_SLOT_OFFSET_SECTORS
	int "Sectors to skip at the start of the target slot"
	depends on KFSW_FWU
	default 1
	range 0 8
	help
	  MCUboot's swap-using-offset mode expects the image one sector into the
	  secondary slot. An image written at the start is not swapped and the
	  old image keeps running.

	  Set to 0 only for a swap mode that expects the image at the slot start.

config KFSW_HEALTH
	bool "K-FSW health monitoring"
	depends on KFSW_WATCHDOG
	help
	  Supervise registered components and stop feeding the watchdog when one
	  misses its deadline, so the watchdog resets the board and MCUboot can
	  revert an unconfirmed image.

config KFSW_HEALTH_MAX_COMPONENTS
	int "Components that can be watched"
	depends on KFSW_HEALTH
	default 8
	range 1 32
	help
	  Number of components that can be watched.

config KFSW_HEALTH_INTERVAL_MS
	int "How often deadlines are checked, in milliseconds"
	depends on KFSW_HEALTH
	default 1000
	range 50 60000
	help
	  Must be well below the watchdog feed interval; a slower check resets
	  the board even when nothing is wrong.

config KFSW_FWU_LITE
	bool "K-FSW lightweight firmware upload"
	depends on KFSW_FWU
	select CRC
	help
	  Direct CSP path for uploading a firmware image, next to the file
	  transfer route. Both use the same update service, and while one
	  transfer runs the other gets busy. Each block has its own checksum.

config KFSW_FWU_LITE_BLOCK_SIZE
	int "Image block size in bytes"
	depends on KFSW_FWU_LITE
	default 192
	range 16 512
	help
	  Payload of one block, the same as the file transfer chunk so a block
	  fits one CSP buffer. Every block except the last must have this size.

config KFSW_FWU_LITE_CSP
	bool "Serve lightweight firmware upload over CSP"
	depends on KFSW_FWU_LITE
	depends on KFSW_CSP
	default y
	help
	  Bind the upload server to a CSP port and add the sending side. The
	  unit tests build the protocol without it.

config KFSW_FWU_LITE_CSP_PORT
	int "CSP port for firmware upload"
	depends on KFSW_FWU_LITE_CSP
	default 13
	range 1 CSP_PORT_MAX_BIND
	help
	  Ports in use: 9 file transfer, 10 parameter transactions, 11 commands,
	  12 parameter list, 14 housekeeping. Port 0 is libcsp's own management
	  protocol and 1 is its ping.

config KFSW_FWU_LITE_RDP
	bool "Use reliable delivery for firmware upload"
	depends on KFSW_FWU_LITE_CSP
	default n
	help
	  Off by default. Blocks are already checked and resent, and RDP adds
	  timeouts that can stall a transfer on a bad link.

config KFSW_FWU_LITE_TIMEOUT_MS
	int "Reply timeout in milliseconds"
	depends on KFSW_FWU_LITE_CSP
	default 8000
	range 100 60000

config KFSW_FWU_LITE_HOST_FILES
	bool "Read images straight from the host filesystem"
	depends on KFSW_FWU_LITE_CSP
	depends on ARCH_POSIX
	default y
	help
	  On a node running as a host process, send an image from a host path
	  without copying it into the simulated flash. Paths under the node's
	  mount point are node files; any other path is a host file.

config KFSW_FWU_LITE_STACK_SIZE
	int "Upload server stack size in bytes"
	depends on KFSW_FWU_LITE_CSP
	default 2048
	range 1024 8192

config KFSW_FWU_LITE_PRIORITY
	int "Upload server thread priority"
	depends on KFSW_FWU_LITE_CSP
	default 3

config KFSW_FWU_LITE_BLOCK_RETRIES
	int "Times to repeat a block the node did not accept"
	depends on KFSW_FWU_LITE_CSP
	default 4
	range 0 32

config KFSW_FTP_FIRMWARE_PATH
	string "Reserved upload path that routes to the firmware slot"
	depends on KFSW_FWU
	depends on KFSW_FTP
	default "firmware.bin"
	help
	  A put to this path in the transfer root is written to the firmware
	  update slot instead of the filesystem. The file is never stored, and
	  MCUboot rejects an image without a valid signature.

config KFSW_FWU_STREAM_BUFFER_SIZE
	int "Flash write buffer size in bytes"
	depends on KFSW_FWU
	default 512
	range 64 4096
	help
	  Staging buffer between arriving chunks and the flash write block. Must
	  be a multiple of the flash write block size.

config KFSW_FBO
	bool "File based operations"
	depends on KFSW_COMMAND && KFSW_STORAGE
	select KFSW_EVENT
	help
	  Run a list of commands from a file. Every line is a normal command,
	  and there are no loops or jumps.

config KFSW_FBO_LINES_MAX
	int "Lines one procedure may carry out"
	depends on KFSW_FBO
	range 1 4096
	default 128
	help
	  Maximum number of lines run. Blank and comment lines don't count.

config KFSW_FBO_BYTES_MAX
	int "Maximum procedure file size in bytes"
	depends on KFSW_FBO
	range 128 1048576
	default 65536
	help
	  Includes blank lines and comments. Reading stops at this limit even
	  if the file grows after the run was accepted.

config KFSW_FBO_LINE_MAX
	int "Longest line in bytes"
	depends on KFSW_FBO
	range 32 512
	default 128
	help
	  Long enough for a command and four arguments. A longer line is cut and
	  fails.

config KFSW_FBO_WAIT_MAX_S
	int "Longest a wait line may ask for"
	depends on KFSW_FBO
	range 1 86400
	default 600
	help
	  Longest wait a procedure can ask for.

config KFSW_FBO_EVENT_LOOKBACK
	int "Events an if-event line looks back through"
	depends on KFSW_FBO
	range 1 256
	default 32
	help
	  How many recent events an if-event guard checks. Keep it below the
	  ring depth.

config KFSW_FBO_STACK_SIZE
	int "Procedure thread stack size"
	depends on KFSW_FBO
	range 1024 8192
	default 3072
	help
	  Stack of the procedure thread, which runs the command handlers.

config KFSW_FBO_PRIORITY
	int "Procedure thread priority"
	depends on KFSW_FBO
	range 0 15
	default 5
	help
	  Below the router and the servers.

config KFSW_HK
	bool "K-FSW housekeeping service"
	depends on KFSW_PARAM
	help
	  Collect a set of parameters in one request. Reading remote values
	  needs KFSW_PARAM_CSP, and serving requests needs KFSW_HK_CSP.

if KFSW_HK

config KFSW_HK_REPORTS
	int "Reports that can be defined"
	default 4
	range 1 16
	help
	  Each report holds its own definition and its own ring of samples, so
	  this multiplies both the definition storage and KFSW_HK_HISTORY.

config KFSW_HK_REMOTE_BUDGET_MS
	int "Total remote read budget per HK report in milliseconds"
	default 1000
	range 10 60000
	help
	  Shared across nodes, descriptor lookup, queue admission and value reads.
	  Expired entries remain zero and the sample is marked incomplete.
	  Local sample callbacks and driver calls must supply their own bounds.

config KFSW_HK_ENTRIES
	int "Parameters one report may name"
	default 16
	range 1 64
	help
	  An upper bound on the definition, not on what fits: a report is also
	  refused if its values exceed KFSW_HK_SAMPLE_BYTES, which is usually
	  the limit reached first.

config KFSW_HK_HISTORY
	int "Samples each report keeps"
	default 16
	range 1 256
	help
	  Samples kept per report. At a one-minute period, 16 samples cover 16
	  minutes.

	  Costs KFSW_HK_REPORTS * this * KFSW_HK_SAMPLE_BYTES of static RAM.

config KFSW_HK_SAMPLE_BYTES
	int "Bytes one sample may occupy, header included"
	default 192
	range 32 240
	help
	  Largest sample, which is one CSP packet. 192 matches file transfer,
	  commands and firmware update.

config KFSW_HK_PERIOD_FLOOR_MS
	int "Shortest period a report may be given"
	default 1000
	range 100 3600000
	help
	  Shortest collection period accepted.

config KFSW_HK_STACK_SIZE
	int "Collection thread stack size"
	default 2560
	range 1024 16384
	help
	  Collection holds a parameter value on the stack, and a string
	  parameter is around 120 bytes of it.

config KFSW_HK_PRIORITY
	int "Collection thread priority"
	default 4
	help
	  Below the router and the servers.

config KFSW_HK_STORE
	bool "Keep collected samples in a file"
	depends on KFSW_STORAGE
	help
	  Write samples to /kfsw/hk so they survive a reset. Each report has one
	  fixed-size ring file that doesn't grow.

config KFSW_HK_STORE_CAPACITY
	int "Samples one report's file holds"
	depends on KFSW_HK_STORE
	range 8 8192
	default 256
	help
	  Records per file. A record is ten bytes of header plus the report's
	  values. A 64 kB partition has about 40 kB free after LittleFS.

config KFSW_HK_STORE_FLOOR_MS
	int "Shortest store interval a report may be given"
	depends on KFSW_HK_STORE
	range 1000 3600000
	default 10000
	help
	  Shortest store interval accepted, to limit flash wear.

config KFSW_HK_STORE_ADVISED_MS
	int "Store interval below which a warning is logged"
	depends on KFSW_HK_STORE
	range 1000 86400000
	default 600000
	help
	  Store intervals between the floor and this value are accepted with a
	  warning showing the writes per day and the erase budget.

config KFSW_HK_STORE_ERASE_CYCLES
	int "Erase cycles one flash block is rated for"
	depends on KFSW_HK_STORE
	range 100 1000000
	default 10000
	help
	  Erase cycles of the storage flash, used in the store interval warning.
	  The default suits the STM32L4 internal flash.

config KFSW_HK_CSP
	bool "Answer housekeeping requests over CSP"
	depends on KFSW_CSP
	default y
	help
	  Serve collected samples to other nodes over CSP.

config KFSW_HK_BEACON
	bool "Send samples unprompted"
	depends on KFSW_HK_CSP
	help
	  Send a report's newest sample periodically without a request. Beacons
	  have a minimum interval, can be turned off, and are skipped when CSP
	  buffers are short.

config KFSW_HK_BEACON_FLOOR_MS
	int "Shortest beacon interval a report may be given"
	depends on KFSW_HK_BEACON
	range 1000 3600000
	default 5000
	help
	  Shortest beacon interval accepted.

config KFSW_HK_BEACON_PORT
	int "CSP port a beacon is addressed to"
	depends on KFSW_HK_BEACON
	range 1 16
	default 15
	help
	  Destination port of beacons. Nothing binds it, so a beacon can't reach
	  another node's request handler. Ground listeners use the source port.

config KFSW_HK_BEACON_BUFFER_RESERVE
	int "CSP buffers a beacon will not take"
	depends on KFSW_HK_BEACON
	range 1 64
	default 4
	help
	  Skip a beacon when fewer CSP buffers than this are free.

config KFSW_HK_CSP_PORT
	int "CSP port for housekeeping requests"
	depends on KFSW_HK_CSP
	default 14
	range 1 CSP_PORT_MAX_BIND
	help
	  Ports in use: 9 file transfer, 10 parameter transactions, 11 commands,
	  12 parameter list, 13 firmware upload.

config KFSW_HK_SERVER_STACK_SIZE
	int "Housekeeping server thread stack size"
	depends on KFSW_HK_CSP
	default 2048
	range 1024 16384

config KFSW_HK_SERVER_PRIORITY
	int "Housekeeping server thread priority"
	depends on KFSW_HK_CSP
	default 3

config KFSW_HK_PERSISTENCE
	bool "Keep report definitions across a reset"
	depends on KFSW_STORAGE
	select CRC
	default y
	help
	  Save report definitions to /kfsw/hk with a CRC, through a temporary
	  file. Without this, definitions are lost at reset.

endif # KFSW_HK

endmenu
```
